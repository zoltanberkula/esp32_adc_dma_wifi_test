## main/Kconfig.projbuild
```kconfig
# put here your custom config value
menu "Example Configuration"
config ESP_WIFI_SSID
    string "MY_SSID"
    default "myssid"
    help
	SSID (network name) for the example to connect to.

config ESP_WIFI_PASSWORD
    string "MY_STA_PASSWORD"
    default "mypassword"
    help
	WiFi password (WPA or WPA2) for the example to use.

config ESP_AP_WIFI_SSID
    string "MY_AP_SSID"
    default "myssid"
    help
	AP SSID (network name) for the example to connect to.

config ESP_AP_WIFI_PASSWORD
    string "MY_AP_PASSWORD"
    default "mypassword"
    help
	AP WiFi password (WPA or WPA2) for the example to use.
	
config ESP_TCP_SERVER_IPV4
    string "MY_TCP_SERVER_IP"
    default "tcp server ip"
    help
	AP WiFi password (WPA or WPA2) for the example to use.
endmenu
```
